## config/west.yml
```yaml
manifest:
  remotes:
    - name: zmkfirmware
      url-base: https://github.com/zmkfirmware
    - name: tokazio
      url-base: https://github.com/tokazio
  projects:
    - name: zmk
      remote: tokazio
      revision: b002b25
      import: app/west.yml
  self:
    path: config
```
